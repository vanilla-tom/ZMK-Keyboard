## config/west.yml
```yaml
manifest:
  remotes:
    - name: zmk-fork
      url-base: https://github.com/vanilla-tom
  projects:
    - name: zmk
      remote: zmk-fork
      revision: 3ed0add88fe426eecba1841bd75ab4fcd44e90da
      import: app/west.yml
  self:
    path: config
```
